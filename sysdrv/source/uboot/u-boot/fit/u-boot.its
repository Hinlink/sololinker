## sysdrv/source/uboot/u-boot/fit/u-boot.its
```
/*
 * Copyright (C) 2020 Rockchip Electronic Co.,Ltd
 *
 * Simple U-boot fit source file containing ATF/OP-TEE/U-Boot/dtb/MCU
 */

/dts-v1/;

/ {
	description = "FIT Image with ATF/OP-TEE/U-Boot/MCU";
	#address-cells = <1>;

	images {

		uboot {
			description = "U-Boot";
			data = /incbin/("u-boot-nodtb.bin.lzma");
			type = "standalone";
			arch = "arm";
			os = "U-Boot";
			compression = "lzma";
			load = <0x00200000>;
			digest {
				value = /incbin/("./u-boot-nodtb.bin.digest");
				algo = "sha256";
			};
			hash {
				algo = "sha256";
			};
		};
		fdt {
			description = "U-Boot dtb";
			data = /incbin/("./u-boot.dtb");
			type = "flat_dt";
			arch = "arm";
			compression = "none";
			hash {
				algo = "sha256";
			};
		};
	};

	configurations {
		default = "conf";
		conf {
			description = "rv1106-evb";
			rollback-index = <0x0>;
			
			loadables = "uboot";
			
			fdt = "fdt";
			signature {
								algo = "sha256,rsa2048";
				
				key-name-hint = "dev";
				sign-images = "loadables", "fdt";
			};
		};
	};
};
```
